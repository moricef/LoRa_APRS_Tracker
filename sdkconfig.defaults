## sdkconfig.defaults
```kconfig
# Arduino as ESP-IDF component
CONFIG_AUTOSTART_ARDUINO=y
CONFIG_FREERTOS_HZ=1000

# SPIRAM (PSRAM) - OPI mode for ESP32-S3 N16R8
CONFIG_SPIRAM=y
CONFIG_SPIRAM_MODE_OCT=y
CONFIG_SPIRAM_SPEED_80M=y
CONFIG_SPIRAM_USE_MALLOC=y
CONFIG_SPIRAM_MALLOC_ALWAYSINTERNAL=4096

# Bluetooth (NimBLE)
CONFIG_BT_ENABLED=y
CONFIG_BT_NIMBLE_ENABLED=y
CONFIG_BT_NIMBLE_MEM_ALLOC_MODE_EXTERNAL=y
CONFIG_BT_NIMBLE_MAX_CONNECTIONS=1

# C++ exceptions (required by PSRAMAllocator, ArduinoJson, etc.)
CONFIG_COMPILER_CXX_EXCEPTIONS=y

# AsyncTCP core assignment
CONFIG_ASYNC_TCP_RUNNING_CORE=0

# Flash size 16MB (N16R8 module)
CONFIG_ESPTOOLPY_FLASHSIZE_16MB=y

# FatFS - Long File Name support (required for SD card paths > 8.3)
CONFIG_FATFS_LFN_HEAP=y
CONFIG_FATFS_MAX_LFN=255

# Logging colors
CONFIG_LOG_COLORS=y

# Increase stack sizes to prevent overflow
CONFIG_ARDUINO_LOOP_STACK_SIZE=32768
CONFIG_ESP_WIFI_TASK_STACK_SIZE=6144
```
